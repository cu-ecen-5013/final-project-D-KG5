## base_external/package/aesd-assignments/Config.in
```kconfig
config BR2_PACKAGE_AESD_ASSIGNMENTS
	bool "aesd-assignments"
	help
	  Includes the gettemp.sh script, client1, and sensor programs in the kernel image.
	  Also includes their startup scripts
```
